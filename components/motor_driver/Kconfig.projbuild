## components/motor_driver/Kconfig.projbuild
```kconfig
menu "Button"

    config BUTTON_PIN
        int "GPIO external power pin"
        range 0 36
        default 0
        help
            GPIO pin number to be system enabled.

    config BUTTON_PIN_INVERTED
        bool "Inverted value from external pin?"
        default TRUE
        help
            Inverted value from external power pin.

endmenu
```

## main/Kconfig.projbuild
```kconfig
menu "Electronic Throttle Controller Unit"

    config INDICATOR_PIN
        int "Indicator pin"
        default 10

    config MODE_SWITCH_PIN
        int "Mode switch pin"
        default 11

    config BREAK_SWITCH_PIN
        int "Break switch pin"
        default 12

    config GUARD_SWITCH_PIN
        int "Guard switch pin"
        default 13

    config CLUTCH_SWITCH_PIN
        int "Clutch switch pin"
        default 14

    config TWIST_SENSOR_1_PIN
        int "Twist sensor 1 pin"
        default 15

    config TWIST_SENSOR_2_PIN
        int "Twist sensor 2 pin"
        default 16

#     menu "Wheel"
#
#         config WHEEL_SENSOR_PIN
#             int "Wheel sensor pin"
#             default 11
#             help
#                 GPIO number
#
#         config WHEEL_DIAMETER
#             int "Wheel diameter"
#             default 17
#             help
#                 Wheel diameter in inches
#
#         config WHEEL_MINIMAL_SPEED
#             int "Wheel minimal speed"
#             default 5
#             help
#                 Wheel minimal speed in m/s
#
#     endmenu
#
#     menu "Pump"
#
#         config PUMP_PIN
#             int "Pump pin"
#             default 9
#             help
#                 GPIO number
#
#         config PUMP_TIMEOUT
#             int "Pump timeout"
#             default 60
#             help
#                 Pump timeout in seconds, after pump is disable
#     endmenu
#
#     config DISTANCE_OF_ENABLE
#         int "Distance of enable"
#         default 500000
#         help
#             Distance in meters

endmenu
```

## sdkconfig.defaults
```kconfig
CONFIG_IDF_TARGET="esp32s3"
CONFIG_IDF_TARGET_ESP32S3=y

CONFIG_ESPTOOLPY_FLASHSIZE_4MB=y
CONFIG_ESPTOOLPY_FLASHSIZE="4MB"

CONFIG_COMPILER_CXX_EXCEPTIONS=y
CONFIG_COMPILER_CXX_RTTI=y

CONFIG_FREERTOS_HZ=1000

CONFIG_ESP_INT_WDT=n
CONFIG_INT_WDT=n
CONFIG_ESP_TASK_WDT_EN=n
CONFIG_ESP_TASK_WDT_INIT=n
```
